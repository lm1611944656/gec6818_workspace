/dts-v1/;
/include/ "skeleton.dtsi"

/ {
    model = "gec6818 based on Samsung s5p6818";
    compatible = "gec,gec6818";

    chosen {
        compatible = "gec,chosen";
        bootargs = "lcd=at070tn92 tp=gslx680-linux root=/dev/mmcblk0p2 rootfstype=ext4 rw";
    };

    memory {
        compatible = "gec,memory";
        device_type = "memory";
        reg = <0x40000000 0x40000000>; // DDR的内存起始地址和 ~ 内存的大小
    };
};